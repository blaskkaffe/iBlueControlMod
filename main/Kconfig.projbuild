## main/iblue/Kconfig.iblue
```kconfig
# iBlueControlMod and Dreamcast extras. Everything here is optional and off for other builds.
# Included from Kconfig.projbuild; see docs/iblue-extras.md.

menu "iBlueControlMod and Dreamcast extras"

    config BLUERETRO_HW_IBLUECONTROLMOD
        bool "Target iBlueControlMod (internal Dreamcast mod) pinout"
        depends on BLUERETRO_HW2
        default n
        help
            Use the GPIO assignment of the iBlueControlMod board
            (reverse engineered from vendor firmware SEGA_DC_24V01):
            boot/pair button on GPIO16, status LED on GPIO13/GPIO14,
            port LEDs 15/4/2/12, port sense P1=36 P2=35 P3=32 P4=33,
            GPIO17 held low, power-on pin held (not pulsed),
            always "internal" adapter (no GPIO13/14 external detect).

    config BLUERETRO_IBLUE_RGB_LED
        bool "iBlueControlMod: PWM colour driver for the RGB status LED"
        depends on BLUERETRO_HW_IBLUECONTROLMOD
        default y
        help
            Drive the 4-pin common-anode RGB LED (GPIO13/14/25) with 3 PWM
            channels and show one selectable colour: solid when on,
            breathing while pairing, blinking while the button is held.
            Double-tap the button to switch colour (saved in NVS).
            Disable to get the vendor-identical LED behaviour.

    choice BLUERETRO_IBLUE_LED_DEFAULT_COLOR
        prompt "iBlueControlMod: default RGB LED colour"
        depends on BLUERETRO_IBLUE_RGB_LED
        default BLUERETRO_IBLUE_LED_ORANGE

        config BLUERETRO_IBLUE_LED_ORANGE
            bool "Orange (like the original Dreamcast LED)"

        config BLUERETRO_IBLUE_LED_BLUE
            bool "Blue"
    endchoice

    config BLUERETRO_IBLUE_LED_R_GPIO
        int "iBlueControlMod: RGB LED red GPIO"
        depends on BLUERETRO_IBLUE_RGB_LED
        default 25

    config BLUERETRO_IBLUE_LED_G_GPIO
        int "iBlueControlMod: RGB LED green GPIO"
        depends on BLUERETRO_IBLUE_RGB_LED
        default 14

    config BLUERETRO_IBLUE_LED_B_GPIO
        int "iBlueControlMod: RGB LED blue GPIO"
        depends on BLUERETRO_IBLUE_RGB_LED
        default 13

    config BLUERETRO_IBLUE_PAIR_WINDOW_S
        int "iBlueControlMod: pairing window in seconds (0 = unlimited)"
        depends on BLUERETRO_HW_IBLUECONTROLMOD
        default 60
        help
            Pairing (BT inquiry, blinking LEDs) is only allowed for this long
            after the console turns on, or after a button tap. Already paired
            controllers can still reconnect at any time.

    config BLUERETRO_BRCTL
        bool "Dreamcast: BlueRetro control channel over the Maple bus (brctl)"
        depends on BLUERETRO_SYSTEM_DC
        default y if BLUERETRO_HW_IBLUECONTROLMOD
        help
            Answer BLOCK_READ / BLOCK_WRITE / SET_CONDITION frames with the
            private BlueRetro function code on the controller main unit, so
            Dreamcast software (e.g. openMenu) can read status, read/write the
            full BlueRetro config, set the LED and start/stop pairing.
            See main/iblue/brctl_proto.h.

    config BLUERETRO_IBLUE_DC_MENU_COLORS
        bool "Dreamcast: PS4/PS5 light bar colours A orange, B green, C blue, D magenta"
        depends on BLUERETRO_SYSTEM_DC
        default y if BLUERETRO_HW_IBLUECONTROLMOD

    config BLUERETRO_IBLUE_PROFILES
        bool "Dreamcast: controller profiles (Home + face button), per-game settings"
        depends on BLUERETRO_SYSTEM_DC && BLUERETRO_BRCTL
        default y if BLUERETRO_HW_IBLUECONTROLMOD
        help
            Four profile slots (type, rumble/VMU and button mapping of one
            port) kept in flash. Home plus a face button on a Bluetooth
            controller loads a slot for that controller. With the control
            channel (brctl) openMenu can save and load them, and give each
            game its own configuration (loaded by the product number openMenu
            sends before a game starts). The files survive a factory reset.
            See docs/iblue-extras.md.

endmenu
```
