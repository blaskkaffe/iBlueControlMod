## main/Kconfig.projbuild
```kconfig
menu "BlueRetro"

    config BLUERETRO_HW2
        bool "Enable support for HW2 features"
        default y
        help
            Select this to enable HW2 features like port detection.

    config BLUERETRO_HW_IBLUECONTROLMOD
        bool "Target iBlueControlMod (internal Dreamcast mod) pinout"
        depends on BLUERETRO_HW2
        default n
        help
            Use the GPIO assignment of the iBlueControlMod board
            (reverse engineered from vendor firmware SEGA_DC_24V01):
            boot/pair button on GPIO16, status LED on GPIO13/GPIO14,
            port LEDs 15/4/2/12, port sense P1=36 P2=35 P3=32 P4=33,
            GPIO17 held low, power-on pin held (not pulsed),
            always "internal" adapter (no GPIO13/14 external detect).

    config BLUERETRO_IBLUE_RGB_LED
        bool "iBlueControlMod: PWM colour driver for the RGB status LED"
        depends on BLUERETRO_HW_IBLUECONTROLMOD
        default y
        help
            Drive the 4-pin common-anode RGB LED (GPIO13/14/25) with 3 PWM
            channels and show one selectable colour: solid when on,
            breathing while pairing, blinking while the button is held.
            Double-tap the button to switch colour (saved in NVS).
            Disable to get the vendor-identical LED behaviour.

    choice BLUERETRO_IBLUE_LED_DEFAULT_COLOR
        prompt "iBlueControlMod: default RGB LED colour"
        depends on BLUERETRO_IBLUE_RGB_LED
        default BLUERETRO_IBLUE_LED_ORANGE

        config BLUERETRO_IBLUE_LED_ORANGE
            bool "Orange (like the original Dreamcast LED)"

        config BLUERETRO_IBLUE_LED_BLUE
            bool "Blue"
    endchoice

    config BLUERETRO_IBLUE_LED_R_GPIO
        int "iBlueControlMod: RGB LED red GPIO"
        depends on BLUERETRO_IBLUE_RGB_LED
        default 25

    config BLUERETRO_IBLUE_LED_G_GPIO
        int "iBlueControlMod: RGB LED green GPIO"
        depends on BLUERETRO_IBLUE_RGB_LED
        default 14

    config BLUERETRO_IBLUE_LED_B_GPIO
        int "iBlueControlMod: RGB LED blue GPIO"
        depends on BLUERETRO_IBLUE_RGB_LED
        default 13

    config BLUERETRO_IBLUE_PAIR_WINDOW_S
        int "iBlueControlMod: pairing window in seconds (0 = unlimited)"
        depends on BLUERETRO_HW_IBLUECONTROLMOD
        default 60
        help
            Pairing (BT inquiry, blinking LEDs) is only allowed for this long
            after the console turns on, or after a button tap. Already paired
            controllers can still reconnect at any time.

    config BLUERETRO_IBLUE_LED_MAX_PCT
        int "iBlueControlMod: maximum brightness of the LEDs (percent of the PWM duty)"
        depends on BLUERETRO_IBLUE_RGB_LED
        range 10 100
        default 80
        help
            The RGB power LED and the four controller port LEDs never get brighter than this.

    config BLUERETRO_IBLUE_BOOT_ANIM
        bool "iBlueControlMod: controller port LEDs animate while the Dreamcast boot animation plays"
        depends on BLUERETRO_IBLUE_RGB_LED
        default y
        help
            When the console powers on, the four port LEDs show drops falling on water for the
            length of the BIOS boot animation (ripples run along the LEDs and bounce off the ends),
            then show the real state (a lit LED per connected controller). Port LEDs never blink
            unless a Bluetooth controller is connected.

    config BLUERETRO_IBLUE_BOOT_INTRO
        bool "iBlueControlMod: port LEDs A, C, B, D light up and fade out in turn before the drops"
        depends on BLUERETRO_IBLUE_BOOT_ANIM
        default y
        help
            Port A's pin lights by itself while the chip starts. The intro carries on from it: A fades out,
            then C, B and D each come on at full brightness and fade out, then the boot animation.

    config BLUERETRO_IBLUE_BOOT_ANIM_MS
        int "iBlueControlMod: length of the Dreamcast BIOS boot animation (ms)"
        depends on BLUERETRO_IBLUE_BOOT_ANIM
        range 1000 20000
        default 9000
        help
            Time from the console power-on until the boot animation ends. Measure it with a
            stopwatch on your console and set it here.

    config BLUERETRO_IBLUE_BOOT_ANIM_BOOT_MS
        int "iBlueControlMod: time from console power-on until this firmware runs (ms)"
        depends on BLUERETRO_IBLUE_BOOT_ANIM
        range 0 5000
        default 700
        help
            The adapter boots while the console already starts: this much of the animation is
            counted as played when the firmware starts it (bootloader time; the rest is the
            time since the firmware started).

    config BLUERETRO_IBLUE_GAMEID
        bool "iBlueControlMod: Dreamcast game id from openMenu (reserved VMU block 200)"
        depends on BLUERETRO_SYSTEM_DC && BLUERETRO_HW_IBLUECONTROLMOD
        default y
        help
            openMenu writes the product number of the game it starts into one block of the emulated
            VMU (never stored as VMU data). It becomes BlueRetro's game id, so blueretro.io can save
            a configuration per game. Needs the VMU accessory on. See docs/led-and-gameid.md.

    config BLUERETRO_IBLUE_DC_MENU_COLORS
        bool "iBlueControlMod: PS4/PS5 light bar colours A orange, B green, C blue, D magenta"
        depends on BLUERETRO_HW_IBLUECONTROLMOD
        default y

    choice
        prompt "Select universal or specific system"
        default BLUERETRO_SYSTEM_UNIVERSAL
        help
            BlueRetro is an universal adapter but you may force it to support
            only one system.

        config BLUERETRO_SYSTEM_UNIVERSAL
            bool "UNIVERSAL"
            help
                Select this to support all systems.

        config BLUERETRO_SYSTEM_PARALLEL_1P
            bool "PARALLEL_1P_PP"
            help
                Select this to support only PARALLEL_1P push-pull.

        config BLUERETRO_SYSTEM_PARALLEL_2P
            bool "PARALLEL_2P_PP"
            help
                Select this to support only PARALLEL_2P push-pull.

        config BLUERETRO_SYSTEM_NES
            bool "NES"
            help
                Select this to support only NES.

        config BLUERETRO_SYSTEM_PCE
            bool "PCE"
            help
                Select this to support only PCE.

        config BLUERETRO_SYSTEM_GENESIS
            bool "MEGADRIVE/GENESIS"
            help
                Select this to support only MEGADRIVE/GENESIS.

        config BLUERETRO_SYSTEM_SNES
            bool "SNES"
            help
                Select this to support only SNES.

        config BLUERETRO_SYSTEM_CDI
            bool "CD-i"
            help
                Select this to support only CD-i.

        config BLUERETRO_SYSTEM_CD32
            bool "CD32"
            help
                Select this to support only CD32.

        config BLUERETRO_SYSTEM_3DO
            bool "3DO"
            help
                Select this to support only 3DO.

        config BLUERETRO_SYSTEM_JAGUAR
            bool "JAGUAR"
            help
                Select this to support only JAGUAR.

        config BLUERETRO_SYSTEM_PSX_PS2
            bool "PSX/PS2"
            help
                Select this to support only PSX & PS2.

        config BLUERETRO_SYSTEM_SATURN
            bool "SATURN"
            help
                Select this to support only SATURN.

        config BLUERETRO_SYSTEM_PCFX
            bool "PC-FX"
            help
                Select this to support only PC-FX.

        config BLUERETRO_SYSTEM_JVS
            bool "JVS"
            help
                Select this to support only JVS.

        config BLUERETRO_SYSTEM_N64
            bool "N64"
            help
                Select this to support only N64.

        config BLUERETRO_SYSTEM_DC
            bool "DC"
            help
                Select this to support only DC.

        config BLUERETRO_SYSTEM_GC
            bool "GC"
            help
                Select this to support only GC.

        config BLUERETRO_SYSTEM_WII_EXT
            bool "Wii ext."
            help
                Select this to support only Wii ext.

        config BLUERETRO_SYSTEM_VBOY
            bool "VB"
            help
                Select this to support only VB.

        config BLUERETRO_SYSTEM_PARALLEL_1P_OD
            bool "PARALLEL_1P_OD"
            help
                Select this to support only PARALLEL_1P open drain.

        config BLUERETRO_SYSTEM_PARALLEL_2P_OD
            bool "PARALLEL_2P_OD"
            help
                Select this to support only PARALLEL_2P open drain.

        config BLUERETRO_SYSTEM_SEA_BOARD
            bool "SEA Board"
            help
                Select this to support only SEA Board.

    endchoice

    menu "Debug"

        config BLUERETRO_QEMU
            bool "Enable QEMU friendly config"
            help
                Select this to make an image for QEMU.

        config BLUERETRO_WS_CMDS
            bool "Enable websocket cmds"
            help
                Select this to enable websocket cmds.

        config BLUERETRO_BT_DISABLE
            bool "Disable Bluetooth init"
            help
                Select this to disable Bluetooth init.

        config BLUERETRO_BT_H4_TRACE
            bool "Enable Bluetooth H4 tracing"
            help
                Select this to enable Bluetooth H4 tracing.

        config BLUERETRO_BT_SSP_DBG
            bool "Enable Bluetooth SSP debug mode"
            help
                Select this to enable Bluetooth SSP debug mode.

        config BLUERETRO_GENERIC_HID_DEBUG
            bool "Enable Generic HID report debug"
            help
                Select this to enable Generic HID report debug.

        config BLUERETRO_DUMP_HID_DESC
            bool "Enable HID descriptor dump"
            help
                Select this to dump HID descriptor.

        config BLUERETRO_TEST_FALLBACK_REPORT
            bool "Enable testing fallback report"
            help
                Select this to test fallback report.

        config BLUERETRO_RAW_REPORT_DUMP
            bool "Enable RAW report dump"
            help
                Select this to dump RAW report data.

        config BLUERETRO_ADAPTER_BTNS_DBG
            bool "Enable adapter buttons debug"
            help
                Select this to enable adapter buttons debug.

        config BLUERETRO_ADAPTER_RUMBLE_DBG
            bool "Enable adapter rumble debug"
            help
                Select this to enable adapter rumble debug.

        config BLUERETRO_ADAPTER_RUMBLE_TEST
            bool "Enable adapter rumble test"
            help
                Select this to enable adapter rumble test.

        config BLUERETRO_ADAPTER_INPUT_DBG
            bool "Enable adapter input debug"
            help
                Select this to enable adapter input debug.

        config BLUERETRO_ADAPTER_INPUT_MAP_DBG
            bool "Enable adapter input mapping debug"
            help
                Select this to enable adapter input mapping debug.

        config BLUERETRO_WIRED_TRACE
            bool "Enable wired trace"
            help
                Select this to enable wired trace.

        config BLUERETRO_BT_TIMING_TESTS
            bool "Enable Bluetooth timing tests"
            help
                Select this to enable Bluetooth timeing tests.

        config BLUERETRO_BT_REPORT_INTERVAL_STATS
            bool "Print interval between receive Bluetooth HID report"
            depends on BLUERETRO_BT_TIMING_TESTS
            help
                Print interval between receive Bluetooth HID report.

        choice
            prompt "Enable Bluetooth minimum latency test on GPIO26"
            depends on BLUERETRO_BT_TIMING_TESTS
            optional
            help
                Select to enable Bluetooth minimum latency test.

            config BLUERETRO_BT_MIN_LATENCY_TEST_PS3
                bool "PS3"

            config BLUERETRO_BT_MIN_LATENCY_TEST_PS4
                bool "PS4"

            config BLUERETRO_BT_MIN_LATENCY_TEST_PS5
                bool "PS5"

            config BLUERETRO_BT_MIN_LATENCY_TEST_WIIU
                bool "WIIU"

            config BLUERETRO_BT_MIN_LATENCY_TEST_XB1
                bool "XB1"

            config BLUERETRO_BT_MIN_LATENCY_TEST_SW
                bool "SW"

        endchoice

        config BLUERETRO_BTMON_VERBOSE
            bool "Enable verbose loggin into BT monitor"
            help
                Seclect this to enable verbose loggin into BT monitor.

        config BLUERETRO_COVERAGE
            bool "Enable gcov coverage logging"
            help
                Seclect this to enable gcov coverage logging.

    endmenu

endmenu
```
